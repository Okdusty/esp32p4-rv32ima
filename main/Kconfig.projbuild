## main/Kconfig.projbuild
```kconfig
menu "RV32 emulator"

config RV32_DIAGNOSTIC_LOGS
	bool "Enable host diagnostic logs"
	default n
	help
	  Print detailed startup, reset, PSRAM, kernel-header and bridge messages.
	  When disabled, ESP-IDF component logs are also lowered to warnings.
	  The guest console is unaffected.

config RV32_DEBUG_DISPLAY
	bool "Trace display ownership transitions"
	depends on RV32_DIAGNOSTIC_LOGS
	default y
	help
	  Print terminal release/takeover timestamps and input byte counts.

config RV32_DEBUG_USB
	bool "Trace USB controller state"
	depends on RV32_DIAGNOSTIC_LOGS && RV32_USB_PORT_LINUX
	default y
	help
	  Poll and print DWC2 register/link state, count physical interrupts,
	  and report a powered port without a connected device. Disable to
	  remove this diagnostic polling and interrupt-counter overhead.

config RV32_DEBUG_CSR
	bool "Trace unhandled guest CSR accesses"
	depends on RV32_DIAGNOSTIC_LOGS
	default n
	help
	  Print the first twenty unexpected reads and writes. Guest debug-console
	  CSRs keep their normal output regardless of this trace setting.

config RV32_GUEST_RAM_PREFETCH
	bool "Enable ESP32-P4 L2 sequential prefetch for guest RAM"
	default y
	help
	  Configure the ESP32-P4 L2 autoload engine for the Linux RAM window.
	  This is a sequential next-line prefetch hint, not an emulator cache, and
	  its benefit is workload dependent. Disable it when comparing cache or
	  interpreter changes.

config RV32_DECODED_BLOCK_CACHE
	bool "Enable experimental decoded RV32 block cache"
	default n
	help
	  Build an internal-RAM, direct-threaded cache with predecoded register
	  fields and immediates. FENCE.I invalidates the cache for self-modifying
	  code. This is retained for emulator experiments, but is slower than the
	  normal ESP32-P4 path because guest instruction fetches already benefit
	  from the hardware cache. Leave it disabled for production builds.

config RV32_NATIVE_JIT
	bool "Enable experimental native RV32 hot-block JIT"
	depends on IDF_TARGET_ESP32P4 && !ESP_SYSTEM_MEMPROT
	default n
	help
	  Translate frequently repeated RV32 integer basic blocks into native
	  ESP32-P4 RV32 code stored in a bounded PSRAM arena and internal hot tier.
	  Loads and stores validate new pages through checked callbacks, then reuse
	  small tagged host-pointer caches for aligned accesses. Sv32 permissions,
	  uncached DMA pages and MMIO faults retain normal emulator semantics.
	  Atomic, CSR, trap-return and machine-mode code continue through the
	  interpreter.

	  ESP-IDF memory protection intentionally prevents writable executable
	  allocations. Disable Component config -> ESP System Settings -> Memory
	  protection before enabling this experimental option. Leave it disabled
	  when writable executable memory is not acceptable.

config RV32_NATIVE_JIT_SUPERVISOR
	bool "Also translate supervisor-mode (kernel) code"
	depends on RV32_NATIVE_JIT
	default y
	help
	  Run hot Linux kernel regions natively as well as user regions. User
	  code, the kernel, and the kernel with SUM set keep separate data-page
	  caches, so traps switch caches instead of flushing them.

config RV32_NATIVE_JIT_KEEP_KERNEL
	bool "Keep kernel regions across FENCE.I"
	depends on RV32_NATIVE_JIT_SUPERVISOR
	default y
	help
	  Linux executes FENCE.I after mapping every new executable user page,
	  dozens of times a second while programs load.  Keep the compiled
	  kernel regions (and every head's warm-up count) then, and drop only
	  user regions.  A write mapping to a page that compiled kernel code
	  came from, as when Linux patches its text for a static key, makes the
	  next FENCE.I discard everything as before.

config RV32_NATIVE_JIT_KERNEL_LINEAR
	bool "Kernel loads and stores use the linear map directly"
	depends on RV32_NATIVE_JIT_SUPERVISOR
	default y
	help
	  Generated kernel code first checks whether an address lies in the
	  kernel's linear map of guest RAM and, while paging is on, accesses
	  it with a compare and an add, as the interpreter does, instead of a
	  page-cache lookup.  Other addresses, user memory included, keep the
	  page cache: a base register that held one when the region compiled
	  goes there directly, others after a short check.

config RV32_NATIVE_JIT_ASYNC_COMPILE
	bool "Compile native regions on the second core"
	depends on RV32_NATIVE_JIT && !FREERTOS_UNICORE
	default y
	help
	  The emulator core queues hot code for a worker on CPU1 and keeps
	  interpreting it until the region is ready, instead of stopping to
	  compile.  Code generation reads only a copy of the collected
	  instructions; the emulator core installs finished regions, so the
	  directory, links and code arena still change on one core only.

config RV32_NATIVE_JIT_RAM_REFILL
	bool "Resume native execution after ordinary RAM mapping refills"
	depends on RV32_NATIVE_JIT
	default y
	help
	  Refill a missing RAM page mapping from native code and retry the access
	  without leaving the region. Faults, uncached memory and MMIO still exit.

config RV32_NATIVE_JIT_SPLIT_LOAD_PAGES
	bool "Split native load groups predicted to span guest pages"
	depends on RV32_NATIVE_JIT
	default y
	help
	  Use the entry values of unchanged base registers to end load groups at
	  guest page boundaries, avoiding repeated exits from a group's one-page
	  guard. Every load keeps its own runtime checks.

config RV32_GUEST_HLE
	bool "Run the guest kernel's memcpy, memset, division and LZ4 on the host"
	depends on RV32_NATIVE_JIT
	default y
	help
	  Supervisor calls to memcpy, memmove, memset, __div64_32 and the LZ4
	  block decoder (EROFS decompression) run as host code instead of guest
	  instructions.  An entry point is used only when the guest code there
	  is byte-identical to the routine the host replaces (see guest_hle.c),
	  so another kernel build runs its own code.  Device memory, uncached
	  pages, faults, overlapping copies and LZ4 blocks the kernel would not
	  decode in full stay with the guest code.

config RV32_JIT_EXIT_TRACE
	bool "Log native JIT checked exits and rejected candidates"
	depends on RV32_NATIVE_JIT
	default n
	help
	  Aggregate checked memory exits by guest PC, instruction, SATP, address
	  and reason, and count rejected candidates and RAM refills. Prints up to
	  eight hot sites per interval. Perturbs timing; leave it off when
	  measuring performance.

config RV32_JIT_EXIT_TRACE_INTERVAL_MS
	int "JIT exit log interval (milliseconds)"
	depends on RV32_JIT_EXIT_TRACE
	range 1000 60000
	default 2000

config RV32_PSRAM_EMULATOR_STATE
	bool "Place emulator code and large state in PSRAM (experimental)"
	depends on RV32_NATIVE_JIT && SPIRAM_XIP_FROM_PSRAM
	select SPIRAM_ALLOW_BSS_SEG_EXTERNAL_MEMORY
	default n
	help
	  Move the emulator's ordinary code and compiler scratch to PSRAM, and
	  CPU state and JIT directories too unless RV32_HOT_STATE_INTERNAL is set.
	  Frees internal SRAM for a 512 KiB L2 cache, but can be slower.

config RV32_HOT_STATE_INTERNAL
	bool "Keep CPU and JIT dispatch state in internal SRAM"
	depends on RV32_PSRAM_EMULATOR_STATE
	default y if CACHE_L2_CACHE_256KB
	default n
	help
	  Keep guest CPU state, the native block directory, successor links and
	  hot-code directory in internal SRAM while compiler scratch stays in
	  PSRAM. Costs about 94 KiB of internal SRAM, which the 512 KiB L2
	  configuration may not have.

config RV32_EXPERIMENT_PANIC_DOWNLOAD
	bool "Enter ROM download mode after an experimental panic"
	depends on RV32_PSRAM_EMULATOR_STATE && ESP_SYSTEM_PANIC_PRINT_REBOOT
	default y
	help
	  Reboot into ROM download mode on a panic, skipping the panic report, and
	  report DMA heap availability around the startup pool reservation. Meant
	  for allocator failures before app_main, when Linux cannot request a
	  recovery reboot.

config RV32_EMULATOR_PERF_STATS
	bool "Enable RV32 emulator performance counters"
	default n
	help
	  Instrument translation and page-cache paths and report guest MIPS plus
	  the ESP32-P4 L2 data-cache hit rate. Keep this disabled for normal use:
	  the counters deliberately add writes to the instruction hot path.

config RV32_EMULATOR_PERF_INTERVAL_MS
	int "Performance report interval (ms)"
	depends on RV32_EMULATOR_PERF_STATS
	range 1000 60000
	default 5000
	help
	  Time between emulator performance reports on the host UART.

config RV32_CACHE_PERF_STATS
	bool "Sample hardware caches and SD traffic without instruction counters"
	depends on IDF_TARGET_ESP32P4 && !RV32_EMULATOR_PERF_STATS
	default n
	help
	  Sample the L1/L2 instruction and data bus counters for both host cores
	  once per second, together with block-cache requests and bytes. This does
	  not enable emulator instruction, JIT-entry or display-operation profiling.
	  Raw hardware counts are not a calibrated stall-cycle or bandwidth metric. Reports
	  include their time window and the preceding report's cost; UART reporting
	  is excluded from the next cache window but still affects application FPS.
	  The hardware counters are shared diagnostic resources: do not run another
	  cache-counter reader/resetter concurrently. Disable after profiling.

config RV32_HOST_LANE_REPORT
	bool "Report interrupt/task placement and per-task CPU shares"
	default n
	select FREERTOS_GENERATE_RUN_TIME_STATS
	help
	  Diagnostic for the isolation of the I/O lanes from the emulator core.
	  25 s after start, print every allocated interrupt with its CPU and
	  every task with its priority and core; then every 5 s print each
	  task's share of the window by core ("[Lanes]" lines).  Enables
	  FreeRTOS run-time statistics, which add a timer read to every context
	  switch.  Diagnostic builds only.

config RV32_HOST_MICROBENCH
	bool "Print the HP core's cycles per operation at start"
	default n
	help
	  Before the guest starts, time dependent and independent ALU chains,
	  load-use pairs, stores, taken jumps, indirect jumps, calls, predictable
	  and unpredictable branches, MUL and DIV on the emulator core with
	  mcycle and print the cycles per operation as "[MB]" lines.  Diagnostic
	  builds only.

config RV32_HOST_PC_SAMPLER
	bool "Sample the emulator core's PC for a host-side profile"
	depends on IDF_TARGET_ESP32P4
	default n
	help
	  A GPTimer interrupt on CPU0 records the interrupted PC in address
	  buckets (internal SRAM, ROM, firmware text in PSRAM, JIT code arena)
	  and a CPU1 task prints the non-zero buckets as "[PCS]" lines; mapped
	  onto the firmware ELF they show where the emulator core's time goes.
	  Costs about 1 % of CPU0 at 5 kHz and 64 KiB of PSRAM. Disable after
	  profiling.

config RV32_HOST_PC_SAMPLER_HZ
	int "PC samples per second"
	depends on RV32_HOST_PC_SAMPLER
	range 100 20000
	default 5000

config RV32_HOST_PC_SAMPLER_REPORT_MS
	int "PC sampler report interval (ms)"
	depends on RV32_HOST_PC_SAMPLER
	range 1000 60000
	default 5000

config RV32_GUEST_PROFILE
	bool "Profile where guest instructions execute and why code is interpreted"
	default n
	help
	  Count native region entries and loop iterations with emitted counters,
	  tag every interpreted instruction with the reason the interpreter is
	  running, sample interpreted guest PCs, and print a report on the host
	  UART at a fixed interval.
	  Analysis builds only: it adds work to the interpreter loop and four
	  instructions to every native region and loop iteration.  That makes
	  interpretation look dearer than it is, so use it to see where time
	  goes and judge a change's speedup on firmware without it.

config RV32_GUEST_PROFILE_INTERVAL_S
	int "Guest profile report interval (s)"
	depends on RV32_GUEST_PROFILE
	range 5 600
	default 30

config RV32_HOST_PERF_STATS
	bool "Enable host core and display performance counters"
	default n
	select FREERTOS_GENERATE_RUN_TIME_STATS
	help
	  Report CPU0/CPU1 busy time, guest instruction rate, display work,
	  cache-clean traffic, PPA use, and per-operation display cycle costs every
	  five seconds. This has much less overhead than the per-instruction emulator
	  counters, but should still be disabled in normal builds after profiling is
	  complete.

config RV32_HOST_BULK_BUFFERS_PSRAM
	bool "Place bulk host queues in reserved PSRAM"
	depends on SPIRAM
	default y if CACHE_L2_CACHE_256KB || CACHE_L2_CACHE_512KB
	default n
	help
	  Reserve 128 KiB below the native-JIT arena in Linux's unused Image-header
	  prefix and use it for the display payload pool, terminal byte stream,
	  glyph storage, and asynchronous UART TX stream. Their control structures
	  and all hot emulator/JIT lookup state remain in internal RAM.

	  This trades a small portion of the virtio-block read cache for internal
	  RAM headroom. It is enabled automatically with the larger ESP32-P4 L2
	  sizes; disable it only for controlled 128 KiB comparison builds.

endmenu

menu "RV32 Linux hardware bridges"

choice RV32_USB_PORT
	prompt "USB port"
	default RV32_USB_PORT_LINUX
	help
	  Who drives the ESP32-P4 USB 2.0 host port.

config RV32_USB_PORT_LINUX
	bool "Linux (any USB device)"
	help
	  Linux's dwc2 driver owns the controller: memory sticks, hubs,
	  keyboards and mice all work, but every USB interrupt runs through
	  the emulated kernel (about 1.2 ms each), so an idle mouse polled every
	  16 ms takes about a sixth of the guest's CPU.

config RV32_USB_PORT_HID
	bool "Keyboard and mouse on CPU1"
	# One USB-A port: a keyboard and a mouse together need a hub.
	select USB_HOST_HUBS_SUPPORTED
	help
	  ESP-IDF's USB host and HID drivers read boot-protocol keyboards and
	  mice on CPU1 and hand keys, buttons, motion and wheels to Linux as a
	  virtio-input device.  Idle devices cost the guest nothing and mouse
	  motion reaches it at most 100 times a second.  Other USB devices,
	  such as memory sticks, are not available to Linux.

endchoice

config RV32_USB_FULL_SPEED_ONLY
	bool "Limit native USB host to full-speed (compatibility test)"
	depends on RV32_USB_PORT_LINUX
	default n
	help
	  Limit the ESP32-P4 UTMI host and Linux DWC2 controller to USB
	  full-speed (12 Mbit/s). This is useful for diagnosing marginal cables,
	  connectors, or board modifications that cannot sustain high-speed
	  signaling. Leave this disabled for the normal 480 Mbit/s path.

config RV32_DISPLAY_ACCEL
	bool
	help
	  Internal switch for the backend-neutral paravirtual framebuffer command
	  transport. Display backends select this when they provide a packed RGB565
	  scanout surface and a CPU1 service task.

config RV32_VIRTIO_GPU
	bool "Enable standard virtio-gpu 2D device (experimental)"
	depends on RV32_DISPLAY_ACCEL
	default n
	help
	  Expose a standard virtio-mmio GPU at 0x12300000. Linux uses its upstream
	  virtio_gpu DRM driver; no board-specific guest driver is required. Guest
	  XRGB8888 resources are gathered and converted to the backend-neutral
	  RGB565 scanout with the ESP32-P4 PPA on CPU1. This is a 2D/KMS transport,
	  not a virgl or OpenGL accelerator. The existing framebuffer and terminal
	  path remain available as a fallback.

choice RV32_DISPLAY_BACKEND
	prompt "Display backend"
	default RV32_ST7703_DISPLAY
	help
	  Select one physical display. Linux and the accelerated console continue
	  to use the same backend-neutral RGB565 surface and command transport.

config RV32_ST7703_DISPLAY
	bool "Enable Waveshare 720x720 ST7703 display bridge"
	select RV32_DISPLAY_ACCEL
	help
	  Initialize the onboard MIPI-DSI ST7703 panel and expose its RGB565
	  framebuffer to the RV32 guest as a simple-framebuffer device.

config RV32_ST7789_DISPLAY
	bool "Enable ST7789 240x240 SPI display bridge"
	select RV32_DISPLAY_ACCEL
	help
	  Render the Linux framebuffer and accelerated console on an external
	  240x240 ST7789 SPI panel. CPU1 transfers changed RGB565 frames directly
	  from PSRAM through SPI DMA.

config RV32_SSD1306_DISPLAY
	bool "Enable SSD1306 128x32/128x64 I2C display bridge"
	select RV32_DISPLAY_ACCEL
	help
	  Render the accelerated Linux console to an external monochrome SSD1306
	  OLED. The RGB565 virtual surface is converted to the controller's 1-bit
	  page format on CPU1 and transferred only when its contents change.

config RV32_U8G2_DISPLAY
	bool "Enable U8g2 monochrome I2C/SPI display bridge"
	select RV32_DISPLAY_ACCEL
	help
	  Render the accelerated Linux console to any monochrome OLED or LCD
	  that the U8g2 library drives over I2C or 4-wire SPI, for example
	  SH1106, SSD1306, SSD1309, SH1107, SSD1322, SSD1327, ST7565, ST7567,
	  ST7920, UC1701 or PCD8544. CPU1 converts the RGB565 surface to U8g2's
	  1-bit buffer and transfers only the tile rows that changed.

	  Choose the controller, panel, orientation and wiring in the top-level
	  "U8g2 display" menu. Its panel list is generated from the vendored
	  U8g2 sources whenever the project is configured.

config RV32_DISPLAY_NONE
	bool "Headless (UART/SSH only)"
	help
	  Do not initialize a physical display or expose framebuffer MMIO to Linux.

endchoice

config RV32_ST7703_REFRESH_HZ
	int "ST7703 target refresh rate (Hz)"
	depends on RV32_ST7703_DISPLAY
	range 30 60
	default 59
	help
	  Target panel refresh rate. The display bridge derives the MIPI-DPI
	  pixel clock from this value and the Waveshare 720x720 porch timings.
	  59 Hz is close to the panel vendor configuration's 59.22 Hz.

config RV32_ST7703_DSI_DMA_QOS
	int "ST7703 scanout DMA AXI priority"
	depends on RV32_ST7703_DISPLAY
	range 0 15
	default 15
	help
	  Priority of the continuous MIPI-DPI framebuffer reads on the ESP32-P4
	  AXI interconnect. The scanout deadline is real-time, so the default gives
	  it precedence over bursty CPU, USB and SDIO traffic. Lower this only when
	  measuring memory-bus arbitration; too little service can cause a DSI
	  underrun and a blue or briefly blank display.

choice RV32_ST7789_SPI_HOST
	prompt "ST7789 SPI controller"
	depends on RV32_ST7789_DISPLAY
	default RV32_ST7789_SPI2

config RV32_ST7789_SPI2
	bool "SPI2"

config RV32_ST7789_SPI3
	bool "SPI3"

endchoice

config RV32_ST7789_SPI_CLOCK_HZ
	int "ST7789 SPI clock (Hz)"
	depends on RV32_ST7789_DISPLAY
	range 1000000 80000000
	default 40000000
	help
	  Pixel-data clock. 40 MHz is a practical default for short wiring. Lower
	  it if the panel shows corruption or the external wiring is long.

config RV32_ST7789_SPI_MODE
	int "ST7789 SPI mode"
	depends on RV32_ST7789_DISPLAY
	range 0 3
	default 0

config RV32_ST7789_SCLK_GPIO
	int "ST7789 SCLK GPIO"
	depends on RV32_ST7789_DISPLAY
	range 0 54
	default 2

config RV32_ST7789_MOSI_GPIO
	int "ST7789 MOSI GPIO"
	depends on RV32_ST7789_DISPLAY
	range 0 54
	default 3

config RV32_ST7789_CS_GPIO
	int "ST7789 chip-select GPIO (-1 for hardwired select)"
	depends on RV32_ST7789_DISPLAY
	range -1 54
	default 4

config RV32_ST7789_DC_GPIO
	int "ST7789 data/command GPIO"
	depends on RV32_ST7789_DISPLAY
	range 0 54
	default 5

config RV32_ST7789_RESET_GPIO
	int "ST7789 reset GPIO (-1 for none)"
	depends on RV32_ST7789_DISPLAY
	range -1 54
	default 6

config RV32_ST7789_BACKLIGHT_GPIO
	int "ST7789 backlight GPIO (-1 for always on)"
	depends on RV32_ST7789_DISPLAY
	range -1 54
	default 7

config RV32_ST7789_BACKLIGHT_ACTIVE_HIGH
	bool "ST7789 backlight is active high"
	depends on RV32_ST7789_DISPLAY
	default y

config RV32_ST7789_X_GAP
	int "ST7789 column offset"
	depends on RV32_ST7789_DISPLAY
	range 0 320
	default 0
	help
	  Controller RAM column offset for modules whose visible 240x240 window
	  does not start at coordinate zero.

config RV32_ST7789_Y_GAP
	int "ST7789 row offset"
	depends on RV32_ST7789_DISPLAY
	range 0 320
	default 0
	help
	  Controller RAM row offset. Some 240x240 modules require 80 here.

config RV32_ST7789_BGR
	bool "ST7789 uses BGR element order"
	depends on RV32_ST7789_DISPLAY
	default n

config RV32_ST7789_INVERT_COLORS
	bool "Enable ST7789 color inversion"
	depends on RV32_ST7789_DISPLAY
	default y

config RV32_ST7789_SWAP_XY
	bool "Swap ST7789 X and Y axes"
	depends on RV32_ST7789_DISPLAY
	default n

config RV32_ST7789_MIRROR_X
	bool "Mirror ST7789 X axis"
	depends on RV32_ST7789_DISPLAY
	default n

config RV32_ST7789_MIRROR_Y
	bool "Mirror ST7789 Y axis"
	depends on RV32_ST7789_DISPLAY
	default n

config RV32_ST7789_REFRESH_HZ
	int "ST7789 maximum frame-transfer rate (Hz)"
	depends on RV32_ST7789_DISPLAY
	range 1 60
	default 30
	help
	  Maximum rate for transferring changed frames. Idle frames are skipped.
	  The practical limit also depends on the selected SPI clock.

config RV32_ST7789_STARTUP_TEST_PATTERN
	bool "Show ST7789 RGB565 qualification pattern during startup"
	depends on RV32_ST7789_DISPLAY
	default y
	help
	  Show red, green, blue and white vertical bars briefly before Linux starts.
	  The backend also verifies its GPIO pads and waits for SPI DMA completion.
	  If the serial diagnostics pass but this pattern is not visible, investigate
	  panel power, wiring, panel compatibility or a defective display. Disable
	  this option after the hardware has been qualified.

choice RV32_SSD1306_GEOMETRY
	prompt "SSD1306 geometry"
	depends on RV32_SSD1306_DISPLAY
	default RV32_SSD1306_128X64

config RV32_SSD1306_128X32
	bool "128x32"

config RV32_SSD1306_128X64
	bool "128x64"

endchoice

config RV32_SSD1306_I2C_PORT
	int "SSD1306 I2C controller"
	depends on RV32_SSD1306_DISPLAY
	range 0 1
	default 0
	help
	  ESP32-P4 high-power I2C controller used by the OLED.

config RV32_SSD1306_SDA_GPIO
	int "SSD1306 SDA GPIO"
	depends on RV32_SSD1306_DISPLAY
	range 0 54
	default 7

config RV32_SSD1306_SCL_GPIO
	int "SSD1306 SCL GPIO"
	depends on RV32_SSD1306_DISPLAY
	range 0 54
	default 8

config RV32_SSD1306_RESET_GPIO
	int "SSD1306 reset GPIO (-1 for none)"
	depends on RV32_SSD1306_DISPLAY
	range -1 54
	default -1

config RV32_SSD1306_I2C_ADDRESS
	hex "SSD1306 7-bit I2C address"
	depends on RV32_SSD1306_DISPLAY
	range 0x08 0x77
	default 0x3c

config RV32_SSD1306_I2C_CLOCK_HZ
	int "SSD1306 I2C clock (Hz)"
	depends on RV32_SSD1306_DISPLAY
	range 10000 1000000
	default 400000
	help
	  Most SSD1306 modules support 400 kHz. Use suitable external pull-ups at
	  higher bus speeds.

config RV32_SSD1306_INTERNAL_PULLUPS
	bool "Enable internal I2C pull-ups"
	depends on RV32_SSD1306_DISPLAY
	default y
	help
	  Useful for short prototype wiring. External pull-ups are still preferred
	  for a reliable 400 kHz bus.

config RV32_SSD1306_REFRESH_HZ
	int "SSD1306 maximum refresh rate (Hz)"
	depends on RV32_SSD1306_DISPLAY
	range 1 60
	default 30
	help
	  Maximum rate at which CPU1 checks and transfers completed frames. Equal
	  frames are skipped, so an idle display generates no I2C traffic.

config RV32_DISPLAY_FLUSH_INTERVAL_MS
	int "Additional post-VSYNC cache-clean delay (ms)"
	depends on RV32_DISPLAY_ACCEL
	range 0 4
	default 0
	help
	  Dirty writes are naturally coalesced until the panel's hardware VSYNC
	  interrupt. Keep this at zero to clean PSRAM immediately in the vertical
	  blanking window. A non-zero value is available only for bandwidth and
	  timing experiments and increases visible latency.

config RV32_DISPLAY_ASYNC_GUEST
	bool "Continue guest computation during framebuffer presentation"
	depends on RV32_DISPLAY_ACCEL
	default n
	help
	  While CPU1 holds the framebuffer snapshot, keep running the guest and
	  wait for the snapshot only when it next touches framebuffer pixels.

config RV32_DISPLAY_LEGACY_QUIET_MS
	int "Legacy mmap framebuffer quiet period (ms)"
	depends on RV32_DISPLAY_ACCEL
	range 1 100
	default 30
	help
	  Direct mmap clients have no portable end-of-frame notification. Hold their
	  accumulated writes until this much wall-clock time passes without another
	  framebuffer store. This filters scheduler and 100 Hz timer-interrupt gaps
	  inside a slow scanline copy, preventing partially painted frames from being
	  published. Drivers which issue the paravirtual framebuffer fence are not
	  delayed by this setting.

config RV32_DISPLAY_COMMAND_FIFO_DEPTH
	int "Asynchronous framebuffer command FIFO depth"
	depends on RV32_DISPLAY_ACCEL
	range 4 32
	default 16
	help
	  Number of backend-neutral fill, copy, image and tile descriptors that
	  Linux can queue without waiting for the display worker. Descriptors do
	  not contain bitmap data, so increasing this has a small RAM cost.

config RV32_DISPLAY_COMMAND_SLICE
	int "Framebuffer commands processed per CPU1 service slice"
	depends on RV32_DISPLAY_ACCEL
	range 1 16
	default 8
	help
	  Bound one command-drain pass so a continuously full FIFO cannot postpone
	  a pending VSYNC notification. Remaining commands immediately reschedule
	  the service task; no timer delay is added.

config RV32_DISPLAY_PAYLOAD_BLOCK_SIZE
	int "Framebuffer FIFO payload block size (bytes)"
	depends on RV32_DISPLAY_ACCEL
	range 2048 32768
	default 32768
	help
	  Maximum bitmap, tile-index, or font payload accepted in one command.
	  Payload capacity is reported to Linux through the PFB3 mailbox, allowing
	  the same driver to adapt to displays with different resolutions. The
	  32 KiB default halves mailbox submissions for large streamed writes while
	  remaining small enough for a reliable contiguous Linux allocation.

config RV32_DISPLAY_PAYLOAD_BLOCK_COUNT
	int "Framebuffer FIFO payload block count"
	depends on RV32_DISPLAY_ACCEL
	range 2 4
	default 2
	help
	  Number of payload-bearing commands that can be outstanding at once.
	  Blocks are shared by all payload operations instead of being embedded in
	  every command descriptor. The defaults retain 64 KiB of aggregate payload
	  capacity; two larger blocks reduce command overhead without increasing
	  the reserved-memory or cache footprint.

choice RV32_GUEST_CONSOLE
	prompt "OpenWrt interactive console supervisor"
	default RV32_GUEST_CONSOLE_HVC
	help
	  Select the PID 1 console supervisor installed into a newly built OpenWrt
	  initramfs. Both programs remain in the image, allowing the generated
	  /etc/rv32-console file to be changed for development without rebuilding
	  either binary.

config RV32_GUEST_CONSOLE_HVC
	bool "Accelerated virtio-console display shell"
	help
	  Use the standard Linux virtio-console hvc0 device. UART0 input enters the
	  hvc receive virtqueue and CPU1 renders the TERM=linux byte stream without
	  making Linux draw every glyph through fbcon. This is the fastest mode.

config RV32_GUEST_CONSOLE_MUX
	bool "Legacy tty0 + ttyS0 console-mux"
	help
	  Run the original guest-side console multiplexer. Linux renders tty0 via
	  fbcon and console-mux mirrors output to ttyS0. This is slower but useful
	  as a compatibility and comparison path.

endchoice

config RV32_GUEST_DROPBEAR
	bool "Start Dropbear SSH server in OpenWrt"
	default y
	help
	  Generate an Ed25519 host key when needed and start Dropbear on port 22.
	  Disable this to skip both key generation and SSH server startup. The
	  package remains available in the initramfs for manual testing.

config RV32_FLASH_ROFS
	bool "Serve a read-only guest filesystem from flash (desktop)"
	default n
	help
	  Flash a read-only filesystem image into the 16 MiB "rofs" partition
	  and expose it as a virtio disk, which the guest mounts at /opt. Files
	  are read from flash on demand and cost no guest RAM. Disable for the
	  image without the desktop.

config RV32_FLASH_ROFS_IMAGE
	string "Read-only filesystem image (absolute, or relative to the project)"
	depends on RV32_FLASH_ROFS
	default "build/guest/rofs-desktop.erofs"
	help
	  Built by scripts/build-desktop-rofs.sh or scripts/build-rofs.sh. If it
	  is missing, the partition keeps whatever was flashed before.

config RV32_FLASH_XIP
	bool "Map read-only desktop files in place from the \"xip\" partition"
	default n
	help
	  Map the "xip" flash partition (a cramfs image of uncompressed,
	  page-aligned files) through the flash MMU and show it to the guest
	  as read-only physical memory at 0x40000000 (GUEST_XIP_BASE, the
	  "mtd-rom" node in uc.dts).  Linux mounts it with cramfs as mtd:xip
	  and maps executables, libraries and fonts straight from flash, so
	  their pages take no page cache.  The partition must lie below
	  16 MiB: quad flash is cache-mapped with 24-bit addresses.  Use
	  partitions-xip.csv and a desktop disk built with RV32_DESKTOP_XIP=1
	  (scripts/build-desktop-rofs.sh), whose mapped files are links into
	  /opt/xip.

config RV32_FLASH_XIP_IMAGE
	string "XIP image (absolute, or relative to the project)"
	depends on RV32_FLASH_XIP
	default "build/guest/xip-desktop.cramfs"
	help
	  Written by mkcramfs-xip.py.  If it is missing, the partition keeps
	  whatever was flashed before.

endmenu

menu "RV32 Linux wireless bridge"

config RV32_WIFI_BRIDGE
	bool "Enable ESP32-C6 SDIO Wi-Fi bridge"
	default y
	help
	  Connect the onboard ESP32-C6 over four-bit SDIO and expose its
	  station Ethernet frames to the RV32 Linux guest through virtio-net.

config RV32_WIFI_SSID
	string "Wi-Fi station SSID"
	depends on RV32_WIFI_BRIDGE
	default ""
	help
	  Leave empty to bring up the C6 and eth0 without associating.  This
	  value is passed only to the C6 control plane; Linux owns DHCP and IP.

config RV32_WIFI_PASSWORD
	string "Wi-Fi station password"
	depends on RV32_WIFI_BRIDGE
	default ""
	help
	  WPA/WPA2/WPA3 passphrase used by the C6 station interface.

config RV32_WIFI_LOW_LATENCY
	bool "Disable C6 Wi-Fi modem power saving"
	depends on RV32_WIFI_BRIDGE
	default y
	help
	  Keep the C6 radio awake while associated. This reduces packet batching
	  and latency and usually improves sustained receive throughput, at the
	  cost of increased power consumption.

config RV32_WIFI_HT40
	bool "Allow 40 MHz 802.11n channel bandwidth"
	depends on RV32_WIFI_BRIDGE
	default y
	help
	  Allow the C6 to negotiate HT40 with a compatible access point. The
	  connection automatically remains at 20 MHz when the access point or
	  surrounding channel conditions do not permit HT40.

endmenu
```
